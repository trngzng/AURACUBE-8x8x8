/*
		RGB CUBE Animations MK4
		Nick Schulze September 2013
		HowNotToEngineer.com
*/

#include "Text.h"

uint8_t outside[23][8][3];
uint8_t scrollFinished = 0;

const char words[NUM_WORDS][MAX_WORD_LENGTH] = { "WELCOME TO " };

const uint8_t alphabet[26][8] =
{ {0x18,0x3C,0x42,0xC3,0xFF,0xC3,0xC3,0xC3} /*A*/
,{0x3F,0xC3,0xC3,0x3F,0x43,0xC3,0x43,0x3F} /*B*/
,{0xFC,0xFE,0x3,0x3,0x3,0x3,0xFE,0xFC} /*C*/
,{0x1F,0x7F,0xE3,0xC3,0xC3,0xE3,0x7F,0x1F} /*D*/
,{0xFF,0x3,0x3,0xFF,0xFF,0x3,0x3,0xFF} /*E*/
,{0xFF,0xFF,0x3,0x3,0x1F,0x3,0x3,0x3} /*F*/
,{0xFF,0xFF,0x3,0xF3,0xC3,0xC3,0xFF,0xFF} /*G*/
,{0xC3,0xC3,0xC3,0xFF,0xFF,0xC3,0xC3,0xC3} /*H*/
,{0xFF,0xFF,0x18,0x18,0x18,0x18,0xFF,0xFF} /*I*/
,{0xFF,0xFF,0x60,0x60,0x60,0x63,0x7F,0x3E} /*J*/
,{0xE3,0x33,0x1B,0xF,0xF,0x1B,0x33,0xE3} /*K*/
,{0x3,0x3,0x3,0x3,0x3,0x3,0xFF,0xFF} /*L*/
,{0x81,0xC3,0xE7,0xFF,0xDB,0xC3,0xC3,0xC3} /*M*/
,{0xC3,0xC7,0xCF,0xDB,0xF3,0xE3,0xC3,0xC3} /*N*/
,{0xFF,0xFF,0xC3,0xC3,0xC3,0xC3,0xFF,0xFF} /*O*/
,{0x7F,0xFF,0xC3,0xC3,0x7F,0x3,0x3,0x3} /*P*/
,{0x1C,0x3E,0x63,0x63,0x63,0x22,0x7E,0x9C} /*Q*/
,{0x3F,0xC3,0xC3,0xC3,0x3F,0x33,0x63,0xC3} /*R*/
,{0xFE,0x3,0x3,0x3E,0x60,0xC0,0x60,0x3F} /*S*/
,{0xFF,0xFF,0x18,0x18,0x18,0x18,0x18,0x18} /*T*/
,{0xC3,0xC3,0xC3,0xC3,0xC3,0xC3,0xFF,0x3C} /*U*/
,{0xC3,0xC3,0xC3,0xC3,0xC3,0x66,0x3C,0x18} /*V*/
,{0xC3,0xC3,0xC3,0xDB,0xFF,0xE7,0xC3,0x81} /*W*/
,{0xC3,0x66,0x3C,0x18,0x18,0x3C,0x66,0xC3} /*X*/
,{0xC3,0xC3,0xC3,0x42,0x7E,0x18,0x18,0x18} /*Y*/
,{0xFF,0x7F,0x30,0x18,0xC,0x6,0xFF,0xFF} /*Z*/
};


const char words7[NUM_WORDS][MAX_WORD_LENGTH] = { "LED CUBE " };

const uint8_t alphabet7[26][8] =
{ {0xC,0x12,0x21,0x21,0x3F,0x21,0x21,0x21} /*A*/
,{0x1F,0x21,0x21,0x1F,0x21,0x21,0x21,0x1F} /*B*/
,{0x3E,0x3,0x1,0x1,0x1,0x1,0x3,0x3E} /*C*/
,{0x1F,0x21,0x21,0x41,0x41,0x21,0x21,0x1F} /*D*/
,{0x3F,0x1,0x1,0x3F,0x1,0x1,0x1,0x3F} /*E*/
,{0x3F,0x1,0x1,0x1,0xF,0x1,0x1,0x1} /*F*/
,{0x3F,0x1,0x1,0x1,0x39,0x21,0x21,0x3F} /*G*/
,{0x21,0x21,0x21,0x21,0x3F,0x21,0x21,0x21} /*H*/
,{0x7F,0x8,0x8,0x8,0x8,0x8,0x8,0x7F} /*I*/
,{0x7F,0x10,0x10,0x10,0x10,0x11,0x11,0x1F} /*J*/
,{0x11,0x9,0x5,0x3,0x5,0x9,0x11,0x21} /*K*/
,{0x1,0x1,0x1,0x1,0x1,0x1,0x1,0x3F} /*L*/
,{0x41,0x63,0x55,0x49,0x41,0x41,0x41,0x41} /*M*/
,{0x41,0x43,0x45,0x49,0x51,0x51,0x61,0x41} /*N*/
,{0x3F,0x21,0x21,0x21,0x21,0x21,0x21,0x3F} /*O*/
,{0x1F,0x21,0x21,0x21,0x1F,0x1,0x1,0x1} /*P*/
,{0xC,0x33,0x21,0x21,0x21,0x29,0x33,0x4C} /*Q*/
,{0x1F,0x21,0x21,0x21,0x1F,0x9,0x11,0x21} /*R*/
,{0x3E,0x1,0x1,0x1E,0x20,0x20,0x20,0x1F} /*S*/
,{0x7F,0x8,0x8,0x8,0x8,0x8,0x8,0x8} /*T*/
,{0x21,0x21,0x21,0x21,0x21,0x21,0x21,0x1E} /*U*/
,{0x21,0x21,0x21,0x21,0x21,0x21,0x12,0xC} /*V*/
,{0x41,0x41,0x41,0x41,0x49,0x55,0x63,0x41} /*W*/
,{0x41,0x22,0x14,0x8,0x8,0x14,0x22,0x41} /*X*/
,{0x21,0x21,0x21,0x21,0x3F,0x20,0x10,0xF} /*Y*/
,{0x3F,0x20,0x10,0x8,0x4,0x2,0x1,0x3F} /*Z*/
};

const uint8_t alphabet5[26][8] =
{ {0x0,0x1C,0x22,0x3E,0x22,0x22,0x0,0x0} /*A*/
,{0x0,0x1E,0x22,0x1E,0x22,0x1E,0x0,0x0} /*B*/
,{0x0,0x3E,0x2,0x2,0x2,0x3E,0x0,0x0} /*C*/
,{0x0,0xE,0x12,0x22,0x12,0xE,0x0,0x0} /*D*/
,{0x0,0x3E,0x2,0x3E,0x2,0x3E,0x0,0x0} /*E*/
,{0x0,0x3E,0x2,0x1E,0x2,0x2,0x0,0x0} /*F*/
,{0x0,0x3E,0x2,0x32,0x22,0x3E,0x0,0x0} /*G*/
,{0x0,0x22,0x22,0x3E,0x22,0x22,0x0,0x0} /*H*/
,{0x0,0x3E,0x8,0x8,0x8,0x3E,0x0,0x0} /*I*/
,{0x0,0x7E,0x10,0x10,0x12,0x1E,0x0,0x0} /*J*/
,{0x0,0x22,0x12,0xE,0x12,0x22,0x0,0x0} /*K*/
,{0x0,0x2,0x2,0x2,0x2,0x3E,0x0,0x0} /*L*/
,{0x0,0x22,0x36,0x2A,0x22,0x22,0x0,0x0} /*M*/
,{0x0,0x22,0x26,0x2A,0x32,0x22,0x0,0x0} /*N*/
,{0x0,0x3E,0x22,0x22,0x22,0x3E,0x0,0x0} /*O*/
,{0x0,0x1E,0x22,0x1E,0x2,0x2,0x0,0x0} /*P*/
,{0x0,0x1E,0x12,0x12,0x1E,0x20,0x0,0x0} /*Q*/
,{0x0,0x1E,0x22,0x1E,0xA,0x32,0x0,0x0} /*R*/
,{0x0,0x3E,0x2,0x3E,0x20,0x3E,0x0,0x0} /*S*/
,{0x0,0x3E,0x8,0x8,0x8,0x8,0x0,0x0} /*T*/
,{0x0,0x22,0x22,0x22,0x22,0x1C,0x0,0x0} /*U*/
,{0x0,0x22,0x22,0x22,0x14,0x8,0x0,0x0} /*V*/
,{0x0,0x22,0x22,0x2A,0x36,0x22,0x0,0x0} /*W*/
,{0x0,0x22,0x14,0x8,0x14,0x22,0x0,0x0} /*X*/
,{0x0,0x22,0x14,0x8,0x8,0x8,0x0,0x0} /*Y*/
,{0x0,0x3E,0x10,0x8,0x4,0x3E,0x0,0x0} /*Z*/
};

const uint8_t IT[2][8] =
{ {0xFF,0xFF,0x18,0x18,0x18,0x18,0xFF,0xFF} /*I*/
,{0xFF,0xFF,0x18,0x18,0x18,0x18,0x18,0x18} /*T*/
};

const char wordsScroll[NUM_WORDS_SCROLL][MAX_WORD_LENGTH] = { {"BY "}, {"BJAMES "} };

const uint8_t wordsScrollCol[NUM_WORDS_SCROLL][NUM_CHARS_SCROLL][3] = 
{
{{BLUE},{WHITE}},
{{PINK},{GREEN},{PURPLE},{ORANGE},{AQUA},{RED}}
};

/*
{{0x18,0x24,0x42,0x42,0x7E,0x42,0x42,0x42} //A
,{0x3E,0x42,0x42,0x3E,0x42,0x42,0x42,0x3E} //B
,{0x7C,0x2,0x2,0x2,0x2,0x2,0x2,0x7C} //C
,{0x3E,0x42,0x42,0x42,0x42,0x42,0x42,0x3E} //D
,{0x7E,0x2,0x2,0x3E,0x2,0x2,0x2,0x7E} //E
,{0x7E,0x2,0x2,0x2,0x1E,0x2,0x2,0x2} //F
,{0x7E,0x2,0x2,0x2,0x72,0x42,0x42,0x7E} //G
,{0x42,0x42,0x42,0x42,0x7E,0x42,0x42,0x42} //H
,{0x3E,0x8,0x8,0x8,0x8,0x8,0x8,0x3E} //I
,{0x7E,0x20,0x20,0x20,0x20,0x22,0x22,0x3E} //J
,{0x22,0x12,0xA,0x6,0xA,0x12,0x22,0x42} //K
,{0x2,0x2,0x2,0x2,0x2,0x2,0x2,0x7E} //L
,{0x81,0xC3,0xA5,0x99,0x81,0x81,0x81,0x81} //M
,{0x0,0x42,0x46,0x4A,0x52,0x62,0x42,0x0} //N
,{0x7E,0x42,0x42,0x42,0x42,0x42,0x42,0x7E} //O
,{0x3E,0x42,0x42,0x42,0x3E,0x2,0x2,0x2} //P
,{0x0,0x7E,0x42,0x42,0x52,0x62,0x7E,0x80} //Q
,{0x3E,0x42,0x42,0x42,0x3E,0x12,0x22,0x42} //R
,{0x7C,0x2,0x2,0x3C,0x40,0x40,0x40,0x3E} //S
,{0x7F,0x8,0x8,0x8,0x8,0x8,0x8,0x8} //T
,{0x42,0x42,0x42,0x42,0x42,0x42,0x42,0x3C} //U
,{0x42,0x42,0x42,0x42,0x42,0x42,0x24,0x18} //V
,{0x81,0x81,0x81,0x81,0x99,0xA5,0xC3,0x81} //W
,{0x81,0x42,0x24,0x18,0x18,0x24,0x42,0x81} //X
,{0x42,0x42,0x42,0x42,0x7E,0x40,0x20,0x1E} //Y
,{0x7E,0x40,0x20,0x10,0x8,0x4,0x2,0x7E} //Z}
};
*/
int8_t position = 0;
int8_t positionb = 0;
int8_t posSpin = 0;

uint8_t letter_p = 0;
uint8_t inletter_p = 0;
uint8_t current_word = 0;
uint16_t start_colour = 0;

uint8_t rgbPlaneR[8][8];
uint8_t rgbPlaneG[8][8];
uint8_t rgbPlaneB[8][8];

void beginText(void) 
{
	rgb_dir = 1;
	position = SIZE - 1;
	letter_p = 0;

	start_colour += 10;

	if (start_colour > 512)
		start_colour = 0;
}

void animateText(void)
{
	uint8_t x, z;
	uint8_t R, G, B;

	if (rgb_dir == 1)
	{
		for (x = 0; x < SIZE; x++)
		{
			for (z = 0; z < SIZE; z++)
			{
				if (words[current_word][letter_p] != 32)
				{
					if (alphabet[letter(words[current_word][letter_p])][7 - z] & (1 << (x)))
					{
						get_colour(20 * position + start_colour, &R, &G, &B);
						set(x, z, position, R, G, B);
						//arrayP[ar(x, pos, z)] = colourWheel.get_colour(20*pos + start_colour);
					}
				}
			}
		}
	}
	else
	{
		if (position == 0)
			delay(1000);
		for (x = 0; x < SIZE; x++)
		{
			for (z = 0; z < SIZE; z++)
				set(x, z, position, BLACK);
		}
	}
	if (--position < 0)
	{
		if (rgb_dir == 1)
		{
			rgb_dir = 2;
			position = SIZE - 1;
		}
		else
		{
			//setPlaneZ(z,BLACK);
//  		memset(arrayP, 0, SIZE3*sizeof(COLOUR));
			if (!words[current_word][++letter_p])
			{
				letter_p = 0;
				if (++current_word >= NUM_WORDS)
				{
					current_word = 0;
					modeWaitUp = 1;
					delay(300);
				}
//  		fadeOutDone = 1;
			}
			rgb_dir = 1;
			position = SIZE - 1;
		}
	}
	delay(35);
}

void beginText7(void)
{
	rgb_dir = 1;
	position = SIZE - 1;
	positionb = 0;
	posSpin = 0;
	letter_p = 0;
	start_colour += 10;
	if (start_colour > 512)
		start_colour = 0;
}

void textSpin()
{
	uint8_t aPos, bPos, cPos;
	uint8_t x, y, z;

	for (aPos = 0; aPos < 8; aPos++)
	{
		setAll(BLACK);
		for (x = 0; x < 7; x++)
		{
			for (y = 0; y < SIZE; y++)
			{
				for (z = 0; z < 6; z++)
				{
					if (aPos == 7) 
						bPos = 3,cPos = 0;
					if (aPos == 0 || aPos == 4)
						bPos = x;
					if (aPos == 1 || aPos == 5)
						bPos = 3;
					if (aPos == 2)
						bPos = 5 - x, cPos = 1;
					if (aPos == 6)
						bPos = 5 - x, cPos = 0;
					if (aPos == 3)
						bPos = 3;
					if (aPos != 1 && aPos != 5 && z == bPos)
					{
						if (cPos == 0)
							set(x + 1, y, bPos, rgbPlaneR[x][y], rgbPlaneG[x][y], rgbPlaneB[x][y]);
						else
						{
							if (x != 6)
								set(x + 1, y, bPos, rgbPlaneR[5 - x][y], rgbPlaneG[5 - x][y], rgbPlaneB[5 - x][y]);
						}
					}
					if ((aPos == 1 || aPos == 5) && x == bPos)
					{
						if (cPos == 0)
							set(x + 1, y, z, rgbPlaneR[z][y], rgbPlaneG[z][y], rgbPlaneB[z][y]);
						else
							set(x + 1, y, z, rgbPlaneR[5 - z][y], rgbPlaneG[5 - z][y], rgbPlaneB[5 - z][y]);
					}
				}
			}
		}
		delay(150);
	}
}

void animateText7(void)
{
	uint8_t x, y, z;
	uint8_t R, G, B;

	if (rgb_dir == 4)
	{	// spin
		if (posSpin == 0)
		{
			for (x = 0; x < SIZE; x++) 
			{
				for (y = 0; y < SIZE; y++)
				{
					rgbPlaneR[x][y] = getR(x + 1, y, 3);
					rgbPlaneG[x][y] = getG(x + 1, y, 3);
					rgbPlaneB[x][y] = getB(x + 1, y, 3);
				}
			}
		}
		if (words7[current_word][letter_p] != 32) 
			textSpin();
		if (++posSpin > 2)
		{
			delay(200);
			rgb_dir = 1;
			posSpin = 0;
			positionb = 0;
			position--;
		}
	}
	if (rgb_dir == 1)
	{
		for (x = 0; x < SIZE; x++)
		{
			for (z = 0; z < SIZE; z++)
			{
				if (words7[current_word][letter_p] != 32)
				{
					if (alphabet7[letter(words7[current_word][letter_p])][7 - z] & (1 << (x)))
					{
						get_colour(20 * position + start_colour, &R, &G, &B);
						set(x + 1, z, position, R, G, B);
					}
				}
			}
		}
		if (position == 3)
		{
			rgb_dir = 3;
			positionb = 1;
			delay(200);
		}
	}
	else if (rgb_dir == 2)
	{
		if (position == 0)
			delay(1000);
		for (x = 0; x < SIZE; x++)
		{
			for (z = 0; z < SIZE; z++)
				set(x + 1, z, position, BLACK);
		}
	}
	else if (rgb_dir == 3)
	{
		for (x = 0; x < SIZE; x++)
		{
			for (z = 0; z < SIZE; z++)
				set(x + 1, z, SIZE - positionb + 1, BLACK);
		}
	}

	if (positionb == 0)
	{
		if (--position < 0)
		{
			if (rgb_dir == 1)
			{
				rgb_dir = 2;
				position = SIZE - 1;
			}
			else
			{
				if (!words7[current_word][++letter_p])
				{
					letter_p = 0;
					if (++current_word >= NUM_WORDS7)
					{
						current_word = 0;
						modeWaitUp = 1;
						delay(200);
					}
				}

				rgb_dir = 1;
				position = SIZE - 1;
			}
		}
	}
	else
	{
		positionb++;
		if (positionb > 5 && rgb_dir != 4)
		{
			delay(200);
			rgb_dir = 4;
		}
	}
	delay(20);
}


void initScrollText()
{
	current_word = 0;
	letter_p = 0;
	inletter_p = 0;
	scrollFinished = 0;
}

void moveOutside()
{
	uint8_t i, k;
	uint8_t R, G, B;
	for (i = 0; i < 28; i++)
	{
		for (k = 0; k < 8; k++)
		{
			if (i < 6)
			{
				R = getR(7, k, i + 2);
				G = getG(7, k, i + 2);
				B = getB(7, k, i + 2);
				set(7, k, i + 1, R, G, B);
			}
			if (i > 5 && i < 14)
			{
				R = getR(12 - i, k, 7);
				G = getG(12 - i, k, 7);
				B = getB(12 - i, k, 7);
				set(13 - i, k, 7, R, G, B);
			}
			if (i > 13 && i < 21)
			{
				R = getR(0, k, 20 - i);
				G = getG(0, k, 20 - i);
				B = getB(0, k, 20 - i);
				set(0, k, 21 - i, R, G, B);
			}
			if (i > 20)
			{
				R = getR(i - 20, k, 0);
				G = getG(i - 20, k, 0);
				B = getB(i - 20, k, 0);
				set(i - 21, k, 0, R, G, B);
			}
		}
	}

};

void scrollText(uint8_t number)
{
	uint8_t R, G, B;
	uint8_t k, l;
	uint8_t space = 0;

	if (wordsScroll[current_word][letter_p] == 32) space = 1;
	for (k = 0; k < 8; k++)												//读取数据
	{
		R = wordsScrollCol[current_word][letter_p][0];
		G = wordsScrollCol[current_word][letter_p][1];
		B = wordsScrollCol[current_word][letter_p][2];
		l = 1 << inletter_p;
		if ((alphabet7[letter(wordsScroll[current_word][letter_p])][k] & l) && !space && !scrollFinished)
			set(7, 7 - k, 0, R, G, B);
		else
			set(7, 7 - k, 0, BLACK);
	}
	inletter_p++;
	if (inletter_p > 7)
	{
		inletter_p = 0;
		if (wordsScroll[current_word][letter_p] == 32)
		{
			if (current_word < NUM_WORDS_SCROLL - 1)
				current_word++;
			else
				scrollFinished = 1;
			letter_p = 0;
		}
		else
			letter_p++;
	}
	moveOutside();
	if (scrollFinished && isClearAll(showLED))
		modeWaitUp = 1;
}

void spinIT()
{
	uint8_t aPos, bPos, cPos;
	uint8_t x, y, z;

	for (aPos = 0; aPos < 4; aPos++)
	{
		setAll(BLACK);
		for (x = 0; x < SIZE; x++)
		{
			for (y = 0; y < SIZE; y++)
			{
				for (z = 0; z < SIZE; z++)
				{
					if (aPos == 0)
						bPos = x - 1, cPos = x;
					if (aPos == 1)
						bPos = 3, cPos = 5;
					if (aPos == 2)
						bPos = 7 - x + 1, cPos = 7 - x;
					if (aPos == 3)
						bPos = 3,cPos = 4; 
					if (aPos == 0 && z == bPos)
					{
						if (x < 7)
							set(x, y, bPos, rgbPlaneR[x][y], rgbPlaneG[x][y], rgbPlaneB[x][y]);
						if (x < 7 && x > 0)
							set(x - 1, y, cPos, rgbPlaneR[x][y], rgbPlaneG[x][y], rgbPlaneB[x][y]);
					}
					if ((aPos == 1) && x == bPos)
					{
						set(x, y, z, rgbPlaneR[z][y], rgbPlaneG[z][y], rgbPlaneB[z][y]);
						set(x + 1, y, z, rgbPlaneR[z][y], rgbPlaneG[z][y], rgbPlaneB[z][y]);
					}
					if (aPos == 2 && z == bPos)
					{
						if (x > 1)
							set(x, y, bPos, rgbPlaneR[x - 1][y], rgbPlaneG[x - 1][y], rgbPlaneB[x - 1][y]);
						if (x > 1)
							set(x - 1, y, cPos, rgbPlaneR[x - 1][y], rgbPlaneG[x - 1][y], rgbPlaneB[x - 1][y]);
					}
					if (aPos == 3 && z == bPos)
					{
						set(x, y, bPos, rgbPlaneR[x][y], rgbPlaneG[x][y], rgbPlaneB[x][y]);
						set(x, y, cPos, rgbPlaneR[x][y], rgbPlaneG[x][y], rgbPlaneB[x][y]);
					}
				}
			}
		}
		delay(100);
	}
}
